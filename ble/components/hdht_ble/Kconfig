## ble/components/hdht_ble/Kconfig
```kconfig
menu "hdht BLE link"

    config HDHT_BLE_TX_QUEUE
        int "Bytes of outgoing data that can wait for notification buffers"
        default 8192

endmenu
```

## ble/main/Kconfig.projbuild
```kconfig
menu "hdht BLE demo"

    config HDHT_BLE_SEED_BYTE
        hex "Seed byte for the key pair (0x33 = the same key the firmware/ app announces on the DHT)"
        default 0x33

endmenu
```

## examples/app_template/main/Kconfig.projbuild
```kconfig
menu "Distributed app template"

config APP_NAME
    string "Device name, published in its record (no quotes)"
    default "app-template"

config APP_ISSUER
    string "Manufacturer whose credentials the device accepts (did:mw:<hex>), empty for none"
    default ""
    help
        See docs/credentials.md. Anyone may hand the device a credential;
        it keeps one only if this issuer signed it for this device's key.

config APP_BOOTSTRAP
    string "Bootstrap node (ip:port), empty for the public HyperDHT"
    default ""

endmenu
```

## examples/ble_echo/main/Kconfig.projbuild
```kconfig
menu "hdht BLE demo"

    config HDHT_BLE_SEED_BYTE
        hex "Seed byte for the key pair (0x33 = the same key hyperdht_demo announces on the DHT)"
        default 0x33

endmenu
```

## examples/ble_echo/sdkconfig.defaults
```kconfig
CONFIG_IDF_TARGET="esp32c3"
CONFIG_ESPTOOLPY_FLASHSIZE_4MB=y
CONFIG_PARTITION_TABLE_SINGLE_APP_LARGE=y
CONFIG_COMPILER_OPTIMIZATION_PERF=y

CONFIG_BT_ENABLED=y
CONFIG_BT_NIMBLE_ENABLED=y
CONFIG_BT_NIMBLE_MAX_CONNECTIONS=1
CONFIG_BT_NIMBLE_ROLE_CENTRAL=n
CONFIG_BT_NIMBLE_ROLE_OBSERVER=n
CONFIG_BT_NIMBLE_ATT_PREFERRED_MTU=512
# the Noise handshake (3 Ed25519 DHs) runs on the host task
CONFIG_BT_NIMBLE_HOST_TASK_STACK_SIZE=12288
```

## examples/boat_mer/main/Kconfig.projbuild
```kconfig
menu "BoAT MER over HyperDHT"

config MER_BOOTSTRAP
    string "Bootstrap node (ip:port), empty for the public HyperDHT"
    default ""

config MER_SELLER_KEY
    string "HyperDHT public key (hex) of the seller to buy from, empty to only serve"
    default ""

config MER_ANCHOR_CONTRACT
    string "OpenAnchor contract whose anchor nodes to find and submit signed readings to, empty for none"
    default ""

config MER_ANCHOR_CHAIN_ID
    int "Chain id of the OpenAnchor contract"
    default 5042002

config MER_ANCHOR_NODES
    string "Extra anchor nodes to use without discovery: comma-separated HyperDHT public keys (hex)"
    default ""

config MER_ANCHOR_INTERVAL_S
    int "Seconds between anchored readings"
    default 30

config MER_CHAIN_ID
    int "EIP-712 chainId of the settlement chain"
    default 5042002

config MER_GATEWAY_CONTRACT
    string "EIP-712 verifyingContract (Circle Gateway)"
    default "0x0077777d7EBA4688BDeF3E311b846F25870A19B9"

config MER_BUYER_DOMAIN_NAME
    string "EIP-712 domain name the buyer signs payments under"
    default "GatewayWalletBatched"
    help
        GatewayWalletBatched (version 1, verifyingContract MER_GATEWAY_CONTRACT)
        for Circle Gateway batched settlement. For a seller that settles each
        authorization with the token's own transferWithAuthorization, use the
        token's domain: "USDC" / "2" on Circle's testnets, "USD₮0" / "1" on
        Stable, with MER_BUYER_VERIFYING_CONTRACT set to the token.

config MER_BUYER_DOMAIN_VERSION
    string "EIP-712 domain version the buyer signs payments under"
    default "1"

config MER_BUYER_VERIFYING_CONTRACT
    string "EIP-712 verifyingContract for the buyer's payments, empty for MER_GATEWAY_CONTRACT"
    default ""

config MER_BUYER_CHAIN_ID
    int "EIP-712 chainId for the buyer's payments, 0 for MER_CHAIN_ID"
    default 0
    help
        For a token on another chain than the anchor nodes' payments, e.g.
        2201 for USD₮0 on the Stable testnet.

config MER_OWNER_KEY
    string "Owner's HyperDHT public key (hex) that may ask the device to sign, empty for none"
    default ""
    help
        A stream from this key to the device's DID carries signing requests
        (main/signer.c) instead of an attested reading: the device is then a
        remote signer for the owner's WDK wallet app.

config MER_SIGNER_MAX_VALUE
    int "Most base units of the token the device signs over in one authorization for its owner"
    default 100000

config MER_JOB_MAX_BUDGET
    int "Most a job the device asks for may cost, in base units of the registry's token"
    default 100000000
    help
        The device signs its own job requests (owner op post_job) for
        BoatRegistry.postJobFromDevice up to this budget. The budget comes from
        the device's balance on the registry, which its owner funds.

config MER_SOL_MINT
    string "Solana SPL token mint the device signs transfers of for its owner (base58), empty for none"
    default ""
    help
        With CONFIG_MER_OWNER_KEY, the owner can also have the device sign SPL
        Token transfers of this mint (USD₮ on Solana:
        Es9vMFrzaCERmJfrF4H2FYD4KCoNkY11McCe8BenwNYB) out of its own token
        account, with a Solana key derived from the DID key (main/solana.h),
        at most CONFIG_MER_SIGNER_MAX_VALUE base units per transaction. The
        fee payer is the owner's account: the device holds no SOL.

config MER_X402_URL
    string "x402 URL the device calls and pays for, empty for none"
    default ""

config MER_X402_INTERVAL_S
    int "Seconds between x402 calls"
    default 60

config MER_X402_MAX
    int "Most base units the device pays for one x402 call"
    default 10000

config MER_X402_SELL_PORT
    int "HTTP port the device sells attested readings on with x402, 0 for none"
    default 0
    help
        GET /reading costs MER_X402_SELL_PRICE base units of the EIP-3009
        token MER_X402_SELL_TOKEN, paid to the device's own address. The
        device checks each payment itself and has MER_X402_SELL_FACILITATOR
        settle it before it answers.

config MER_X402_SELL_FACILITATOR
    string "x402 facilitator URL that settles the device's sales (POST <url>/settle)"
    default ""

config MER_X402_SELL_PRICE
    int "Price of a reading, in base units of the token"
    default 1000

config MER_X402_SELL_CHAIN_ID
    int "Chain id of the token readings are paid in"
    default 5042002

config MER_X402_SELL_TOKEN
    string "EIP-3009 token readings are paid in"
    default "0x3600000000000000000000000000000000000000"

config MER_X402_SELL_TOKEN_NAME
    string "The token's EIP-712 domain name"
    default "USDC"

config MER_X402_SELL_TOKEN_VERSION
    string "The token's EIP-712 domain version"
    default "2"

config MER_OTA_CORE
    string "Hypercore of firmware releases to update from (key, hex), empty for none"
    default ""
    help
        Releases appended by packages/boat-ota (boat-ota publish). The device
        checks every block against the core's signed tree, signed by
        MER_OTA_SIGNER, and boots a newer release of MER_OTA_NAME.

config MER_OTA_SIGNER
    string "The release publisher's Ed25519 public key (hex)"
    default ""

config MER_OTA_SERVER
    string "A peer serving the core over HyperDHT (its public key, hex: boat-ota seed prints it)"
    default ""

config MER_OTA_NAME
    string "The product name releases are published under, empty for the project name"
    default ""

config MER_OTA_INTERVAL_S
    int "Seconds between update checks"
    default 3600

config MER_MQTT_NODE
    string "MQTT network name, or a node's public key in hex (empty: off)"
    default ""
    help
        Publish attested readings to an MQTT network over HyperDHT
        (packages/boat-mqtt-node) and pay the node per message with EIP-3009
        authorizations, in the buyer's token and domain (CONFIG_MER_BUYER_*).

config MER_MQTT_VERIFIERS
    string "Verify keys of the verifiers to trust for the MQTT node list"
    default ""
    help
        Comma-separated verify keys (hex) of verifier nodes
        (packages/boat-registry). When set, the device connects only to the
        staked nodes a quorum of them lists (components/hdht_mqtt node list),
        reading the list again every 10 minutes. Empty: CONFIG_MER_MQTT_NODE
        (or the node the owner set) as before.

config MER_MQTT_INTERVAL_S
    int "Seconds between readings published over MQTT"
    default 5

config MER_MQTT_MAX_PAY
    int "Most the device pays an MQTT node at once, in token base units"
    default 100000
    help
        On top of this, the device never pays more than it counted itself
        (the node's price times its own messages and bytes) plus the node's
        stated credit.

config MER_X402_STACK
    int "x402 task stack size"
    default 12288

config MER_TASK_STACK
    int "hdht loop task stack size"
    default 20480

endmenu
```

## examples/uart_module/main/Kconfig.projbuild
```kconfig
menu "hyperdht module"

choice MODULE_PORT
    prompt "Command port"
    default MODULE_PORT_USB
    help
        Where the host sends AT commands. USB Serial/JTAG is the dev board's
        USB port (move the console off it, see sdkconfig.defaults). UART1 is
        two pins wired to the host MCU.

config MODULE_PORT_USB
    bool "USB Serial/JTAG"

config MODULE_PORT_UART
    bool "UART1"

endchoice

config MODULE_UART_TX_PIN
    int "UART1 TX pin (to the host's RX)"
    depends on MODULE_PORT_UART
    default 4

config MODULE_UART_RX_PIN
    int "UART1 RX pin (from the host's TX)"
    depends on MODULE_PORT_UART
    default 5

config MODULE_UART_BAUD
    int "UART1 baud rate"
    depends on MODULE_PORT_UART
    default 115200

config MODULE_ISSUER
    string "Only accept manufacturer credentials from this issuer (did:mw:<hex>), empty for any"
    default ""

config MODULE_ZK
    bool "Verify camera events with zero-knowledge proofs (AT+ZKROOT)"
    default y
    help
        Checks event_v2 messages that arrive on links against a registry root
        set with AT+ZKROOT, and reports each with +ZK (docs/module-uart.md).
        Costs about 27 KB of static RAM and 145 KB of flash, and once a root
        is set a task with a 24 KB stack. The clock is set by SNTP.

config MODULE_ZK_WINDOW
    int "Accept events whose time is within this many seconds of the clock"
    depends on MODULE_ZK
    range 5 60
    default 30

config MODULE_SNTP_SERVER
    string "SNTP server"
    depends on MODULE_ZK
    default "pool.ntp.org"

config MODULE_BOOTSTRAP
    string "Bootstrap node (ip:port), empty for the public HyperDHT"
    default ""

endmenu
```

## firmware/main/Kconfig.projbuild
```kconfig
menu "hdht demo"

    config HDHT_BOOTSTRAP
        string "Bootstrap node (ip:port), empty = public HyperDHT"
        default "192.168.31.89:49800"

    config HDHT_SERVER_KEY
        string "Server public key to connect to (hex)"
        default "d04ab232742bb4ab3a1368bd4615e4e6d0224ab71a016baf8520a332c9778737"
        help
            Default is the key printed by poc/host/testnet.js --server.

    config HDHT_CONNECT_ROUNDS
        int "Connections to make (to check for leaks)"
        default 3

    config HDHT_ROUND_INTERVAL_MS
        int "Pause between client rounds"
        default 1000
        help
            hyperdht allows one random-port holepunch per 20 s per node, so
            use more than 20000 when a peer is behind a random (mobile) NAT.

    config HDHT_SERVE_SECONDS
        int "Then listen as a server for this long (0 = skip)"
        default 120

    config HDHT_SERVER_SEED_BYTE
        hex "Seed byte for the board's server key pair (seed = 32 x this byte)"
        default 0x33

    config HDHT_TASK_STACK
        int "Stack of the task running the event loop"
        default 20480

endmenu
```

## poc/main/Kconfig.projbuild
```kconfig
menu "Holepunch PoC"

    config POC_PEER_HOST
        string "Echo peer IPv4 address"
        default "192.168.31.89"
        help
            Address of the machine running host/echo-server.js.

    config POC_PEER_PORT
        int "Echo peer UDP port"
        default 9000

    config POC_LOCAL_PORT
        int "Local UDP port"
        default 9001

    config POC_ECHO_BYTES
        int "Bytes to send per echo run"
        default 262144

    config POC_CHUNK_BYTES
        int "Bytes per udx_stream_write"
        default 1024

    config POC_MAX_INFLIGHT_WRITES
        int "Unacked writes allowed in flight"
        default 16

    config POC_RWND_LIST
        string "Receive windows to test (bytes, comma separated, 0 = libudx default 4 MB)"
        default "16384,65536,0"

    config POC_HEAP_LEAVE_FREE
        int "Squeeze free heap to this many bytes before each echo run (0 = off)"
        default 0
        help
            Allocates ballast blocks before each run so the stack is tested
            under memory pressure, then frees them afterwards.

    config POC_BLAKE2B_IRAM
        bool "Place libsodium's BLAKE2b compression function in IRAM"
        default n
        help
            blake2b_compress_ref is ~21 KB of unrolled code, larger than the
            16 KB instruction cache, so it thrashes when run from flash.
            Placing it in IRAM costs the same amount of internal RAM.

endmenu
```
